#include "include/AngleTest.h"
#include "include/CatchGame.h"
#include "include/Game2048.h"
#include "include/Globals.h"
#include "include/HardwareManager.h"
#include "include/LcdRelated.h"
// ================================================================
// Main Menu Configuration
// ================================================================
constexpr uint8_t MENU_ITEMS = 3; // 0=2048, 1=Angle, 2=Catch
constexpr uint8_t MENU_TITLE_Y = 10;
constexpr uint8_t MENU_ITEM_Y0 = 80; // y of first menu item
constexpr uint8_t MENU_ITEM_DY = 50; // vertical spacing
constexpr uint8_t MENU_CURSOR_X = 14;
constexpr uint8_t MENU_TEXT_X = 30;
#define TITLE_COLOR COLOR_CYAN
#define ITEM_COLOR COLOR_WHITE
#define CURSOR_COLOR COLOR_GREEN
#define FUTHERINFO_COLOR COLOR_GRAY
#define BACKGROUND_COLOR COLOR_BLACK

// ================================================================
// Private helpers (main menu only – not shared, so stay in .ino)
// ================================================================
static int8_t menuCursor = 0;

// Draw the static background of the main menu (call once on entry)
static void drawMenuBG() {
    tft.fillScreen(BACKGROUND_COLOR);

    tft.setTextSize(2);
    tft.setTextColor(TITLE_COLOR, BACKGROUND_COLOR);
    tft.setCursor(20, MENU_TITLE_Y);
    tft.print(F("ECE  CAMP"));

    tft.setTextSize(1);
    tft.setTextColor(FUTHERINFO_COLOR, BACKGROUND_COLOR); // grey subtitle
    tft.setCursor(50, 38);
    tft.print(F("Day 2 Project"));

    // Divider line
    tft.drawFastHLine(0, HIGHT_OF_THE_HORIZONTIAL_SAPERATE_LINE_FOR_TITLE_AND_DATAS, TFT_W,
                      FUTHERINFO_COLOR);

    // Static item labels
    tft.setTextSize(2);
    tft.setTextColor(ITEM_COLOR, BACKGROUND_COLOR);
    tft.setCursor(MENU_TEXT_X, MENU_ITEM_Y0);
    tft.print(F("1. Angle Test"));
    tft.setCursor(MENU_TEXT_X, MENU_ITEM_Y0 + MENU_ITEM_DY);
    tft.print(F("2. 2048 Game"));
    tft.setCursor(MENU_TEXT_X, MENU_ITEM_Y0 + 2 * MENU_ITEM_DY);
    tft.print(F("3. Catch Game"));

    // Hint at bottom
    tft.setTextColor(FUTHERINFO_COLOR, BACKGROUND_COLOR);
    tft.setCursor(10, 290);
    tft.print(F("Rotate=select \n Press=enter"));
}

// Erase old cursor, draw at new position
static void drawMenuCursor(int8_t oldPos, int8_t newPos) {
    // Erase old
    tft.fillRect(MENU_CURSOR_X, MENU_ITEM_Y0 + oldPos * MENU_ITEM_DY, 8, 8, BACKGROUND_COLOR);
    // Draw new
    tft.fillRect(MENU_CURSOR_X, MENU_ITEM_Y0 + newPos * MENU_ITEM_DY, 8, 8, CURSOR_COLOR);
}

// ================================================================
// setup / loop
// ================================================================
void setup() {
    initHardware();
    enableEncoderISR(); // start encoder interrupt on main menu
    Serial.println(F("[MENU] drawMenuBG"));
    drawMenuBG();
    drawMenuCursor(0, menuCursor);
    Serial.println(F("[MENU] ready"));
}

void loop() {
    uint32_t fs = millis();
    updateHardware();

    // ---- Encoder navigation ----
    int8_t enc = getEncoderDelta();
    if (enc) {
        int8_t oldCursor = menuCursor;
        menuCursor += enc;
        // menuCursor %= MENU_ITEMS; // wrap around
        if (menuCursor < 0) menuCursor = 0;
        if (menuCursor >= MENU_ITEMS) menuCursor = MENU_ITEMS - 1;
        if (menuCursor ^ oldCursor) drawMenuCursor(oldCursor, menuCursor);
    }

    // ---- Button: enter selected page ----
    if (isButtonPressed()) {
        disableEncoderISR(); // stop ISR while in sub-page
        switch (menuCursor) {
        case 0:
            Serial.println(F("[MENU] -> loopAngleTest"));
            loopAngleTest(); // blocking; returns on exit
            Serial.println(F("[MENU] <- loopAngleTest"));
            break;
        case 1:
            Serial.println(F("[MENU] -> loopGame2048"));
            enterGame2048(); // blocking; returns on exit
            Serial.println(F("[MENU] <- loopGame2048"));
            break;
        case 2:
            Serial.println(F("[MENU] -> loopCatchGame"));
            enterCatchGame();
            Serial.println(F("[MENU] <- loopCatchGame"));
            break;
        default:
            break;
        }
        // Returned from sub-page: redraw main menu and restart ISR
        drawMenuBG();
        drawMenuCursor(0, menuCursor);
        enableEncoderISR();
    }

    FRAME_DELAY(fs);
}

/**
 * @author: martis,JunePigTseng
 * Comment by martis: @JunePigTseng 你寫得code 讓我好想blame你.
 * Comment by June : @martis 這Gemini的鍋 我不背
 * Comment by martis: @June 為什麼部用Claude!!!!!
 * 預祝程式乖乖
MMMMMMMMMMMMMMMMMMMMMMMMMMMMMMMMMMMMMMMMMMMMMMMMMMMMMMMMMMMMMMMMMMMMMMMMMMMMMMMMMMMMMMMMMMMMMMMMMMMMMMMMMMMMMMMMMMMMMMMMMMMMMMMMMMMMMMMMMMMMMMMMMMMMMM
MMMMMMMMMMMMMMMMMMMMMMMMMMMMMMMMMMMMMMMMMMMMMMMMMMMMMMMMMMMMMMMMMMMMMMMMMMMMMMMMMMMMMMMMMMMMMMMMMMMMMMMMMMMMMMMMMMMMMMMMMMMMMMMMMMMMMMMMMMMMMMMMMMMMMM
MMMMMMMMMMMMMMMN00KKKKXXXNNNNNNNNNNNNNNNNNNNNNNNWWNWWWWWWWWWWWWWWWWWWWWWWMMMMMMMMMMMMMMMMMMMMMMMMMMMMMMMMMMMMMWMWWWWNNNNNXXXXNMMMMMMMMMMMMMMMMMMMMMMMM
MMMMMMMMMMMMMMM0oooooodddxxkkkkkkkkkkkkkkkkkkkkkkkkkkkkkOOOOOOOOOOOOOOOO0000000000000KKKKK0000000000000000000OOOOOkkkxxdddooo0WMMMMMMMMMMMMMMMMMMMMMMM
MMMMMMMMMMMMMMM0oooollooddddddxxxxxxxxxdxxxxxxxxxxxxxxxxxxxxxxxxxxxxxxxxxxxxxxxxxxxxxxxxxxxxxxxxxxxxxxxxxxxxxxxxxxdddddoooollOWMMMMMMMMMMMMMMMMMMMMMMM
MMMMMMMMMMMMMMMKxddooooodddxxxxxxxxkxxxxxkxxxkkxxxkkxxkxxxxkxxxxkkxxkkxxkkkkxxxkxxkkkkkkkkkkkkkkkkkkkkkkxxxxxxxxxxxdddddodollOWMMMMMMMMMMMMMMMMMMMMMMM
MMMMMMMMMMMMMMMNkddxddxxkkkkkkkkkOOOOOkkkOkkOOOkkOOOkkOOkkkOOkkkOOOkOOOkOOOOOkkOOOOOOOOOOOOOOOOOOOOOOOOkkkkkkkkkkkkkkxxxxdoodKWMMMMMMMMMMMMMMMMMMMMMMM
MMMMMMMMMMMMMMMMXxoddxxkkkOOOOOOOOOOOOOOOOOOOOOOOOOOOOOOOOOOOOOOOOOOOOOOOOOOOOOOkkkkkkkkkkkkkkkkkOOOOOkkkOOOOkkOOOkkxxddolldKWMMMMMMMMMMMMMMMMMMMMMMMM
MMMMMMMMMMMMMMMMMNOddxxxxkkkkxdolclllodkOOOOOOOOOOOOkOOOOOOkkOkxkOOOOOOOOOOOOOOkkkxxxxkkkkkOOOkOOOkOOkOkkOOOkxddddddxdddookNMMMMMMMMMMMMMMMMMMMMMMMMMM
MMMMMMMMMMMMMMMMMMWXOxxkkkkdc;,,,,,,,,,:oxxkOkxl:::ldxc;clodxo,,cccclxkkkOOOOOOOkkxxxxxkkkOOO0K0OkOKOxOOkkkkkxc,:lc;lxxdoOWMMMMMMMMMMMMMMMMMMMMMMMMMMM
MMMMMMMMMMMMMMMMMMMMXkdkkOxlcooo:,,:lool:cxOd,'';::c,.'c:,,::.'c:;,;:okkkkkOOOOOkkkxxkkkkOOOO0K0OkOK0OkkOkkxkd'.::;,:odlkNMMMMMMMMMMMMMMMMMMMMMMMMMMMM
MMMMMMMMMMMMMMMMMMMMKoldkOddO00Oxc;dO0Oko;oO:.,,;:cl;..;''.;lc,.;cc::dkOOkkkOOOOOkkkkOOOOOOOOOOOkkOK00OkOOkkkx:;clllldolOWMMMMMMMMMMMMMMMMMMMMMMMMMMMM
MMMMMMMMMMMMMMMMMMMMKolokOxk00kkOo:xOkkkx;lOl.;l,;olc'.:ol',ox;.cl:ldxkkOkkkkOOOOOOOOOOOOOkkOO0OkkkkOOkOOOOOOxdodxxxdolckWMMMMMMMMMMMMMMMMMMMMMMMMMMMM
MMMMMMMMMMMMMMMMMMMMKocldOOkxxkoc::::oo:::dOOo,:ccll:;cldo:cdxocllldkkkkkOkkkOOOOOOOOOOkdc::coxOOOOkOOkOOOkkOo;cdxxocclcxWMMMMMMMMMMMMMMMMMMMMMMMMMMMM
MMMMMMMMMMMMMMMMMMMM0olodk00kxxolc::cl:,;okOOOkxxxxxxkOOOOkkkkkkkxxxxxkkkOkkkOOOkkxxddl;:c;,,,;:clllllokxdkkOdcdxdxdlclcxNMMMMMMMMMMMMMMMMMMMMMMMMMMMM
MMMMMMMMMMMMMMMMMMMM0lclox0K0Oxol:;;;:clxOOOOOOOkkddolccccccclloxkkkkOOkkkkkxoc:;,''....''....,,.
.'::;,'ckkOd:ldddocclcdNMMMMMMMMMMMMMMMMMMMMMMMMMMMM
MMMMMMMMMMMMMMMMMMMM0lcloxOKXXKOxoooodxkkOOkdlc::cllloooddooollc:okkkkkkkdc;,.................',..ckOOOo':kOko,;cooc;:lcxNMMMMMMMMMMMMMMMMMMMMMMMMMMMM
MMMMMMMMMMMMMMMMMMMM0lclodOKXXKK0OkkkkkOxo:::ldxk0Kkk0kd0Od00dkKddkkOOko;.....................',..o0Ok0x.'kOkc,:oxxl:clcxNMMMMMMMMMMMMMMMMMMMMMMMMMMMM
MMMMMMMMMMMMMMMMMMMM0l:codOKXXXK0OOkkxl:;cdO0kkxcldllxxokOdOOok0xkOOOd;.......................',.
.:ddc. .dOkxxkkkkkdlccxNMMMMMMMMMMMMMMMMMMMMMMMMMMMM
MMMMMMMMMMMMMMMMMMMM0c:codOK000xxkdl:;:d00xkd;;dxxkOkkxxxxxxxkkkddOOo'........................',.
,oxxd; .dOkkkkkOOkxlccxNMMMMMMMMMMMMMMMMMMMMMMMMMMMM
MMMMMMMMMMMMMMMMMMMM0lclodkOxdolccclokOOOxod0Odddoc:;;;::;'..'::;lxl...........................,..dOkk0k''xOkkkkkOOOxlccxNMMMMMMMMMMMMMMMMMMMMMMMMMMMM
MMMMMMMMMMMMMMMMMMMM0lclodOKKK00OkkOd:lxOOOkdl:;:coddxdl;.....:xkxc............................,.
,odxo; 'xOkkkkOOOOxlccxNMMMMMMMMMMMMMMMMMMMMMMMMMMMM
MMMMMMMMMMMMMMMMMMMMKlclodkXWWKOko;cxddOkdc;:loxkkOkkl'........':;...,;,.....:oddxxdol:,.......'.
.:ddc. 'xOkkkkOOOkxlccxNMMMMMMMMMMMMMMMMMMMMMMMMMMMM
MMMMMMMMMMMMMMMMMMMMKoclodkKXNKkO0kkOOdc;:ldkkOOkkkkkl.............,xKK0l..'lxclONWWWNkodo:...'c,.o0kO0x.'xOkkkkOOOkxllcxNMMMMMMMMMMMMMMMMMMMMMMMMMMMM
MMMMMMMMMMMMMMMMMMMMXoclodkKK0Okkdol:;:ldkOOOkxxxddddd;............lXOxKx.:OKx:kNWNNWXd;;kXk;..::'ckOOOl.'xOkkkO00OOxllcxNMMMMMMMMMMMMMMMMMMMMMMMMMMMM
MMMMMMMMMMMMMMMMMMMMXdclodkKK0kdlccloxkkkxddxkOO00Od:;c'...........lKKkOko0WNl'dNNNNKl:kKXNKc..,c,.'::,.
'dOkkO0000OxolckWMMMMMMMMMMMMMMMMMMMMMMMMMMMM
MMMMMMMMMMMMMMMMMMMMXdclodk000OOOkkkkdooddxk0XWMMXxc;cxd'
....'oO0XNKdlkK0XXKKNO;c0WNNo.'lxOko'......;xOO00KOdddollOWMMMMMMMMMMMMMMMMMMMMMMMMMMMM
MMMMMMMMMMMMMMMMMMMMXdclodk00OOOkkxlloOOxddodkKNNXKklcdOd'  'cc'.   ,ONNNx.
.l0XXXXNN0xkKNXdlOX00K0l'.,;...'coxxxolcclll0MMMMMMMMMMMMMMMMMMMMMMMMMMMMM
MMMMMMMMMMMMMMMMMMMMNxclodk000OOko:l0WWKkkkXNWWNXXWWXo;oOx;,kWXc':;.;KWNNl
.dX0k0Xx:'.oKXNNNNKxONNNx;xXx,...':clllc,;llOMMMMMMMMMMMMMMMMMMMMMMMMMMMMM
MMMMMMMMMMMMMMMMMMMMNxccoox000Oxl;dNMMWKkkkkxxdOKXWMWKc:xOxxXWOo0Xd.'ONNXo..'ldccOKo.
;0NNNNXX0OKXXW0cxXO:...,:llllc'.:lOWMMMMMMMMMMMMMMMMMMMMMMMMMMMM
MMMMMMMMMMMMMMMMMMMMNxclooxO0Oko;lXWWWWWKOkdoooxKNWWWNd;dOxkNWXXXO:..lXNNOoddolclooc,:ONNNN0l,ckXXKxc;dKO:...,:llllc'.;lOWMMMMMMMMMMMMMMMMMMMMMMMMMMMM
MMMMMMMMMMMMMMMMMMMMWxclodkOOOkl,dKxook0kxdkxoolkKOdkKocOK0KNNNWNXx'
.c0NXOxxkkOOOkkkKNNNKko::cONNNc.,dKl....,:cllllccllkWMMMMMMMMMMMMMMMMMMMMMMMMMMMM
MMMMMMMMMMMMMMMMMMMMWkccldxkkkko;okccdddl:clc;,;o0OldxcoOO0KNNNNNOlc:,';d0KK0OOkkOOKXNNKOxdoooloKN0;..,;.....,:ldxkOxolckWMMMMMMMMMMMMMMMMMMMMMMMMMMMM
MMMMMMMMMMMMMMMMMMMMWOccloxkkxkxl:ldxOkOkxxkOkdd0X0xoldOOOkkOOOOxllooolcckOOOOOO0000Okkxoddoooolol'
..    ..:oxOK00OxllckWMMMMMMMMMMMMMMMMMMMMMMMMMMMM
MMMMMMMMMMMMMMMMMMMMWOllodxkkkkxxdloOXWMNK00OOXWWXkddkOOOOOkkkdlcccccccoOXkoxkdk00OOdodddoolc:;'..
...';clxO00000OkdlcckWMMMMMMMMMMMMMMMMMMMMMMMMMMMM
MMMMMMMMMMMMMMMMMMMMM0llodxkkkkkkkkdodxOkxxxolxOkxxkkkkkOkkxkkkkxdooolcdOOdlllo0KK0kdddol:,'....',;..'ckkkkkOO00000kdllckWMMMMMMMMMMMMMMMMMMMMMMMMMMMM
MMMMMMMMMMMMMMMMMMMMM0lloxOOOOOOOOOOOOkxxxxxxxxkOOOkkkkkkkkkkkkkkkkkkko:llllollxOOkkxdoloddxxkkO000o:cx0000KKXXXXXXOolcckWMMMMMMMMMMMMMMMMMMMMMMMMMMMM
MMMMMMMMMMMMMMMMMMMMMOlloxKXNNNNNNNNNNXXXXXNXXXXXXXXXXXXXXXXXXXXXXXXXXK0KKKKKKKXXXXXKKKKXNNNNNNNNNNNNNNWWWWWWWWWWWNOollckWMMMMMMMMMMMMMMMMMMMMMMMMMMMM
MMMMMMMMMMMMMMMMMMMMWOllodONWWXKKXNNXKKXNNXKKXNWWWWWWWWWWWWWWWWWWWWWWWWWWWWWWWWWWWWWWWWWWWWWWWWWWWMMMMMMMMMMMMMMMWKxlllckWMMMMMMMMMMMMMMMMMMMMMMMMMMMM
MMMMMMMMMMMMMMMMMMMMWkclookXWXkkOOKKkkOOKKkOOOKMMMMMMMMMMMMMMMMMMMMMMMMMMMMMMMMMMMMMMMMMMMMMMMMMMMMMMMMMMMMMMMMMWN0oclllkWMMMMMMMMMMMMMMMMMMMMMMMMMMMM
MMMMMMMMMMMMMMMMMMMMWkllolxKNN0OO0XN0OO0NN0O0KNMMMMMMMMMMMMMMMMMMMMMMMMMMMMMMMMMMMMMMMMMMMMMMMMMMMMMMMMMMMMMMMMMWNklclllkWMMMMMMMMMMMMMMMMMMMMMMMMMMMM
MMMMMMMMMMMMMMMMMMMMWxccllo0NWWWWMMMWWWMMMMWWMMMMMMMMMMMMMMMMMMMMMMMMMMMMMMMMMMMMMMMMMMMMMMMMMMMMMMMMMMMMMMMMMMMWXd:colckWMMMMMMMMMMMMMMMMMMMMMMMMMMMM
MMMMMMMMMMMMMMMMMMMMNxcclllONWMMMMMMMMMMMMMMMMMMMMMMMMMMMMMMMMWNNNXXKKNWWNXXXXXKKXWMMMMMMMMMMMMMMMMMMMMMMMMMMMMMWKo:colckWMMMMMMMMMMMMMMMMMMMMMMMMMMMM
MMMMMMMMMMMMMMMMMMMMNxccoolkNWMMMMMMMMMMMMMMMMMMMMMMMMMMMMMMMNkoolcllokX0olllcclldKWMMMMMMMMMMMMMMMMMMMMMMMMMMMMW0c;lolckWMMMMMMMMMMMMMMMMMMMMMMMMMMMM
MMMMMMMMMMMMMMMMMMMMNxcloolkXWMMMMMMMMMMMMMMMMMMMMMMMMMMMMMMWKdcccc:cldOxlc;c:ccclOWMMMMMMMMMMMMMMMMMMMMMMMMMMMMWk:;lolckWMMMMMMMMMMMMMMMMMMMMMMMMMMMM
MMMMMMMMMMMMMMMMMMMMNdcllolxXWMMMMMMMMMMMMMMMMMMMMMMMMMMMMMMMXkl:clccookOo:,clcclokWMMMMMMMMMMMMMMMMMMMMMMMMMMMWNx;;lollOWMMMMMMMMMMMMMMMMMMMMMMMMMMMM
MMMMMMMMMMMMMMMMMMMMNdclloldXWMMMMMMMMMMMMMMMMMMMMMMMMMMMMMMMXOxdoloxxxO0kdodloxxdOWMMMMMMMMMMMMMMMMMMMMMMMMMMMWNx,:oollOWMMMMMMMMMMMMMMMMMMMMMMMMMMMM
MMMMMMMMMMMMMMMMMMMMXdclodldKWWMWWWWWWWWWWWWWWWWWWWWWWWWWWWWWWWWWXKXWWWWWWWWNKXWWWWWWWWWWWWWWWWWWWWWWWWWWWWWWWMWXd,coollOWMMMMMMMMMMMMMMMMMMMMMMMMMMMM
MMMMMMMMMMMMMMMMMMMMKoclododKWWWXXXXXXXXXXXXXXXXXXXXXXXXXXXXXXXXXXXXXXXXXXXXXXXXXXXXXXXXXXXXXXXXXXXXXXXXXXXXXNWWXo,colllOWMMMMMMMMMMMMMMMMMMMMMMMMMMMM
MMMMMMMMMMMMMMMMMMMMKlclloldKWWMMMMMMMMMMMMMMMMMMMMMMMMMMMMMMMMMMMMMMMMMMMMMMMMMMMMMMMMMMMMMMMMMMMMMMMMMMMMMMMMWXl'lolccOMMMMMMMMMMMMMMMMMMMMMMMMMMMMM
MMMMMMMMMMMMMMMMMMMM0l:cloldKWWMMMMMMMMMMMMMMMMMMMMMMMMMMMMMMMMMMMMMMMMMMMMMMMMMMMMMMMMMMMMMMMMMMMMMMMMMMMMMMMMWXl,lollcOMMMMMMMMMMMMMMMMMMMMMMMMMMMMM
MMMMMMMMMMMMMMMMMMMM0lcllooxKWWMMMMMMMMMMMMMMMMMMMMMMMMMMMMMMMMMMMMMMMMMMMMMMMMMMMMMMMMMMMMMMMMMMMMMMMMMMMMMMMMWXl,odollOMMMMMMMMMMMMMMMMMMMMMMMMMMMMM
MMMMMMMMMMMMMMMMMMMM0lcloddkXWMMMMMMMMMMMMMMMMMMMMMMMMMMMMMMMMMMMMMMMMMMMMMMMMMMMMMMMMMMMMMMMMMMMMMMMMMMMMMMMMMWXl;odollOMMMMMMMMMMMMMMMMMMMMMMMMMMMMM
MMMMMMMMMMMMMMMMMMMM0lcloddkXWMMMMMMMMMMMMMMMMMMMMMMMMMMMMMMMMMMMMMMMMMMMMMMMMMMMMMMMMMMMMMMMMMMMMMMMMMMMMMMMMMWXo;odollOMMMMMMMMMMMMMMMMMMMMMMMMMMMMM
MMMMMMMMMMMMMMMMMMMMOccloddOXWMMMMMMMMMMMMMMMMMMMMMMMMMMMMMMMMMMMMMMMMMMMMMMMMMMMMMMMMMMMMMMMMMMMMMMMMMMMMMMMMMWXd:odolcOMMMMMMMMMMMMMMMMMMMMMMMMMMMMM
MMMMMMMMMMMMMMMMMMMMOccloddOXNMWXXXXXXXXXXXXXXXXXXXXXXXXXXXXXXXXXXXXXXXXXXXXXXXXXXXXXXXXXXXXXXXXXXXXXXXXXXXXXNWWNx:odoll0MMMMMMMMMMMMMMMMMMMMMMMMMMMMM
MMMMMMMMMMMMMMMMMMMMOlcloddOXWMWWWWWWWWWWWWWWWWWWWWWWWWWWWWWWWWWWWWWWWWWWWWWWWWWWWWWWWWWWWWWWWWWWWWWWWWWWWWWWWMWNkcodoloKMMMMMMMMMMMMMMMMMMMMMMMMMMMMM
MMMMMMMMMMMMMMMMMMMMOlclodx0NWMMMMMMMMMMMMMMMMMMMMMMMMMMMMMMMMMMMMMMMMMMMMMMMMMMMMWMMMMMMMMMMMMMMMMMMMMMMMMMMMMMW0lldoldKMMMMMMMMMMMMMMMMMMMMMMMMMMMMM
MMMMMMMMMMMMMMMMMMMM0lloodx0NWMMMMMMMMMMMMMMMMMMMN0KNNNX0KNXO0NNNX0KNXOO0O0XKOkKKkOKKOK0O0K0XWMMMMMMNKKKNWWXKKXWWXdldoldXMMMMMMMMMMMMMMMMMMMMMMMMMMMMM
MMMMMMMMMMMMMMMMMMMM0oloodxKNWMMMMMMMMMMMMMMMMMMMN00XNNX00NXO0XNNX00NKkO00KXKOk00kOKKO00k0K0KWMMMMMW0kOOOX0kOOOXWNOooolxNMMMMMMMMMMMMMMMMMMMMMMMMMMMMM
MMMMMMMMMMMMMMMMMMMMKoloodkKNWMMMMMMMMMMMMMMMMMMMMMMMMMMMMMMMMMMMMMMMMMMMMMMMMMMMMMMMMMMMMMMMMMMMMMWX000KWX0OOKNWWXxdolOWMMMMMMMMMMMMMMMMMMMMMMMMMMMMM
MMMMMMMMMMMMMMMMMMMMKoloodOXNWWWWWWWWWWWWWWWWWWWWWWWWWWWWWWWWWWWWWWWWWMWWWWWWWWWWWWWWWWWWWWWWWWWWWWWWWNNWNNNXXXXKK0kdoo0MMMMMMMMMMMMMMMMMMMMMMMMMMMMMM
MMMMMMMMMMMMMMMMMMMMKoclodkOOkkkkkkkkkkkkkkOOOOO000000KKKKKKKKKKKKKKK00000000000OOOOOOOOkkkkkkxxxxxxxddddooooooooooooloKMMMMMMMMMMMMMMMMMMMMMMMMMMMMMM
MMMMMMMMMMMMMMMMMMMMKocloddxxollllllllllloooooodddxxxxxxxxxxxxxxxxxddddooddoollllccc::::::;;;;;;;::::::ccccclllllooodooONMMMMMMMMMMMMMMMMMMMMMMMMMMMMM
MMMMMMMMMMMMMMMMMMMMKocloooddddddxxxxxxkkkxxkxxkxxxxxxkkkkkkkkkkkkkOkkk0KKKKK0OkkOkxxkkkxxddddxxddxxxdxxxxdddxddxddddoold0WMMMMMMMMMMMMMMMMMMMMMMMMMMM
MMMMMMMMMMMMMMMMMMNOocccloodddxxxxxddxddddddddddddddddxxooxkxxkkxdxkxxx0K00000kxkkxoodxxxdddddxxxxxxxxxxxxxxxdddddddddoollxXWMMMMMMMMMMMMMMMMMMMMMMMMM
MMMMMMMMMMMMMMMMWKoc::ccloooooooooooooollllllllllllllllooooooddddooooooddddddooooooooooooollloooooddddddddddooolllloooolllcl0WMMMMMMMMMMMMMMMMMMMMMMMM
MMMMMMMMMMMMMMMW0l::cclllllolllllllllccclccccccccccccccccccccccccccccccccccc::::::::c::cccccccccclllllllllllcccccccccccllcccdXMMMMMMMMMMMMMMMMMMMMMMMM
MMMMMMMMMMMMMMMWx:::cccllloololoooooooooddddddddoddddddddddoddddddooodooooodoooooooooooooooodddddddddoooooodoolloooooolllllcoXMMMMMMMMMMMMMMMMMMMMMMMM
MMMMMMMMMMMMMMMWk::cccclooooollooddoddoddddddddddddddxxxdddddddddddddddddddddddddddddddddddddxxxdxxxxddddddddooodddddooooolldXMMMMMMMMMMMMMMMMMMMMMMMM
MMMMMMMMMMMMMMMWOllooddxxxkkxxkkOkOOOOOOOOOOkkkkkxxkkkkkkkkkkkkOOOOOOOOOOOOOOkkkkkkkkkkkkkkkkkkxxxxxxxxxxxxxxdddddddddddooolxNMMMMMMMMMMMMMMMMMMMMMMMM
MMMMMMMMMMMMMMMMWNNNNNNWWWWWWWWWWWWWMWWWWWWWWWWWWWWWWWWWWWWWWWWWWWMMMMMMMMWWWWWWWWWWWWWWWWWWWNNNNNNNNNNNNNNNNNXXXXXXXXXKKK00KWMMMMMMMMMMMMMMMMMMMMMMMM
MMMMMMMMMMMMMMMMMMMMMMMMMMMMMMMMMMMMMMMMMMMMMMMMMMMMMMMMMMMMMMMMMMMMMMMMMMMMMMMMMMMMMMMMMMMMMMMMMMMMMMMMMMMMMMMMMMMMMMMMMMMMMMMMMMMMMMMMMMMMMMMMMMMMMM
MMMMMMMMMMMMMMMMMMMMMMMMMMMMMMMMMMMMMMMMMMMMMMMMMMMMMMMMMMMMMMMMMMMMMMMMMMMMMMMMMMMMMMMMMMMMMMMMMMMMMMMMMMMMMMMMMMMMMMMMMMMMMMMMMMMMMMMMMMMMMMMMMMMMMM
MMMMMMMMMMMMMMMMMMMMMMMMMMMMMMMMMMMMMMMMMMMMMMMMMMMMMMMMMMMMMMMMMMMMMMMMMMMMMMMMMMMMMMMMMMMMMMMMMMMMMMMMMMMMMMMMMMMMMMMMMMMMMMMMMMMMMMMMMMMMMMMMMMMMMM
 */
